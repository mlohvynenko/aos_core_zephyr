## CMakeLists.txt
```
#
# Copyright (C) 2023 Renesas Electronics Corporation.
# Copyright (C) 2023 EPAM Systems, Inc.
#
# SPDX-License-Identifier: Apache-2.0
#

cmake_minimum_required(VERSION 3.20.0)

find_package(Zephyr REQUIRED HINTS $ENV{ZEPHYR_BASE})

include($ENV{ZEPHYR_BASE}/cmake/app/boilerplate.cmake NO_POLICY_SCOPE)

project(aoszephyrapp)

# ######################################################################################################################
# Config
# ######################################################################################################################

set(AOS_CORE_CONFIG aoscoreconfig.hpp)

# ######################################################################################################################
# Includes
# ######################################################################################################################

zephyr_include_directories(${CMAKE_CURRENT_BINARY_DIR} ${CMAKE_CURRENT_BINARY_DIR}/proto src)
zephyr_include_directories_ifdef(CONFIG_NATIVE_APPLICATION mocks/include)

# ######################################################################################################################
# Build in Aos Root CA
# ######################################################################################################################

if(CONFIG_AOS_ROOT_CA_PATH)
    target_sources(app PRIVATE src/rootca/rootca.S)
endif()

# ######################################################################################################################
# Generate OPTEE TA tables
# ######################################################################################################################

if(CONFIG_TA_DEPLOY_DIR)
    file(MAKE_DIRECTORY ${CMAKE_CURRENT_BINARY_DIR}/optee)

    set(GENERATED_DIRECTORY ${CMAKE_CURRENT_BINARY_DIR}/optee)

    execute_process(
        COMMAND ${PYTHON_EXECUTABLE} ${CMAKE_CURRENT_SOURCE_DIR}/scripts/gen_ta_src.py -s
                ${CMAKE_CURRENT_BINARY_DIR}/${CONFIG_TA_DEPLOY_DIR} -p -o ${GENERATED_DIRECTORY}/ta_table
    )

    include_directories(app PRIVATE ${CMAKE_CURRENT_BINARY_DIR}/${CONFIG_TA_DEPLOY_DIR})
    target_sources(app PRIVATE ${GENERATED_DIRECTORY}/ta_table.c ${GENERATED_DIRECTORY}/ta_table.S)
endif()

# ######################################################################################################################
# Definitions
# ######################################################################################################################

# Aos core configuration
add_definitions(-include ${AOS_CORE_CONFIG})

# ######################################################################################################################
# Compile options
# ######################################################################################################################

# Add stack usage warning
target_compile_options(app PRIVATE -Wstack-usage=2048)

# ######################################################################################################################
# Taget
# ######################################################################################################################

target_sources(
    app
    PRIVATE src/main.cpp
            src/app/app.cpp
            src/clocksync/clocksync.cpp
            src/communication/channelmanager.cpp
            src/communication/tlschannel.cpp
            src/communication/channel.cpp
            src/communication/channelmanager.cpp
            src/downloader/downloader.cpp
            src/iamclient/iamclient.cpp
            src/image/imagehandler.cpp
            src/logger/fsbackend.cpp
            src/logger/fslogreader.cpp
            src/logger/logger.cpp
            src/logprovider/logprovider.cpp
            src/monitoring/resourceusageprovider.cpp
            src/nodeinfoprovider/nodeinfoprovider.cpp
            src/ocispec/ocispec.cpp
            src/provisionmanager/provisionmanagercallback.cpp
            src/resourcemanager/resourcemanager.cpp
            src/runner/runner.cpp
            src/smclient/openhandler.cpp
            src/smclient/smclient.cpp
            src/storage/storage.cpp
            src/utils/checksum.cpp
            src/utils/utils.cpp
)

# use pipe for native posix
target_sources_ifdef(CONFIG_NATIVE_APPLICATION app PRIVATE src/communication/socket.cpp)

# use xenvchan for xen
target_sources_ifndef(CONFIG_NATIVE_APPLICATION app PRIVATE src/communication/xenvchan.cpp)

# Enable vchannels and xrun mocks for native posix
target_sources_ifdef(CONFIG_NATIVE_APPLICATION app PRIVATE mocks/vch/vch.cpp mocks/xrun/xrun.cpp mocks/xstat/xstat.cpp)

# Include domain IPL and dtb for xen_dom0 snippet
target_sources_ifdef(CONFIG_XEN_DOM0 app PRIVATE src/domains/dom_runner.c src/domains/domain_bins.S)

# Include source files for DomD support

target_sources_ifdef(CONFIG_SOC_SERIES_RCAR_GEN4 app PRIVATE src/domains/domd/domd_cfg_spider.c)
target_sources_ifdef(CONFIG_BOARD_RCAR_SALVATOR_XS_M3 app PRIVATE src/domains/domd/domd_cfg_salvator_xs.c)
target_sources_ifdef(CONFIG_BOARD_RCAR_H3ULCB_CA57 app PRIVATE src/domains/domd/domd_cfg_h3ulcb.c)

# Include configuration source file for DomU
target_sources_ifdef(CONFIG_DOMU_ENABLE app PRIVATE src/domains/domu/domu_cfg.c)

# Include HW-specific source file
target_sources_ifndef(CONFIG_NATIVE_APPLICATION app PRIVATE src/bsp/reboot.c src/bsp/mount.c)
target_sources_ifdef(CONFIG_FILE_SYSTEM_LITTLEFS app PRIVATE src/bsp/mount_littlefs.c)
target_sources_ifdef(CONFIG_FAT_FILESYSTEM_ELM app PRIVATE src/bsp/mount_fatfs.c)

# ######################################################################################################################
# Versioning
# ######################################################################################################################

find_package(Git)

if(NOT GIT_FOUND)
    set(GIT_EXECUTABLE git)
endif()

set(CMAKE_MODULE_PATH ${PROJECT_SOURCE_DIR}/cmake)

add_custom_target(
    version
    COMMAND
        ${CMAKE_COMMAND} -D GIT_EXECUTABLE=${GIT_EXECUTABLE} -D INPUT_FILE=${CMAKE_SOURCE_DIR}/src/version.hpp.in -D
        OUTPUT_FILE=${CMAKE_CURRENT_BINARY_DIR}/version.hpp -D GIT_SOURCE_DIR=${CMAKE_SOURCE_DIR} -P
        ${CMAKE_MODULE_PATH}/GenerateVersion.cmake
)

add_dependencies(app version)

# ######################################################################################################################
#  Generate API
# ######################################################################################################################

find_package(CoreAPI)

set(CORE_API_CXX_FLAGS
    -I${CMAKE_CURRENT_SOURCE_DIR}/src
    -I${CMAKE_CURRENT_SOURCE_DIR}/../aos_core_lib_cpp/include
    -imacros
    ${AUTOCONF_H}
    -include
    ${AOS_CORE_CONFIG}
    -DARCH_STACK_PTR_ALIGN=16
)

core_api_generate(${CMAKE_CURRENT_SOURCE_DIR}/../aos_core_api ${CMAKE_CURRENT_SOURCE_DIR}/scripts)

# ######################################################################################################################
# mbedTLS
# ######################################################################################################################

# Enable AESNI for posix 32bit
if(${CONFIG_BOARD_NATIVE_POSIX})
    target_compile_options(mbedTLS INTERFACE -mpclmul -msse2 -maes)
endif()

# WA to have get time on zephyr
target_compile_definitions_ifndef(CONFIG_NATIVE_APPLICATION mbedTLS INTERFACE _POSIX_VERSION=200809L)

# Add Aos psa driver

set(mbedtls_source_dir "${APPLICATION_SOURCE_DIR}/../modules/crypto/mbedtls")
set(aoscore_source_dir "${APPLICATION_SOURCE_DIR}/../aos_core_lib_cpp")

set_source_files_properties(
    ${mbedtls_source_dir}/library/psa_crypto_driver_wrappers_no_static.c ${mbedtls_source_dir}/library/psa_crypto.c
    TARGET_DIRECTORY mbedTLS PROPERTIES HEADER_FILE_ONLY ON
)

target_include_directories(mbedTLSCrypto PRIVATE ${mbedtls_source_dir}/library)

target_sources(
    mbedTLSCrypto
    PRIVATE ${aoscore_source_dir}/src/common/crypto/mbedtls/drivers/psa_crypto_driver_wrappers_no_static.c
            ${aoscore_source_dir}/src/common/crypto/mbedtls/drivers/psa_crypto.c ${mbedtls_source_dir}/library/pk_ecc.c
)

target_sources(mbedTLSX509 PRIVATE ${mbedtls_source_dir}/library/x509write.c)

# ######################################################################################################################
# External libs
# ######################################################################################################################

include(ExternalProject)

zephyr_get_include_directories_for_lang_as_string(CXX includes)
zephyr_get_system_include_directories_for_lang_as_string(CXX system_includes)
zephyr_get_compile_definitions_for_lang_as_string(CXX definitions)
zephyr_get_compile_options_for_lang_as_string(CXX options)

set(external_project_cxx_flags "${includes} ${system_includes} -imacros ${AUTOCONF_H} ${definitions} ${options}")

# ######################################################################################################################
# aos_core_lib_cpp
# ######################################################################################################################

# add mbedTLS includes and defines for Aos core lib
set(mbedtls_includes "-I$<JOIN:$<TARGET_PROPERTY:mbedTLS,INTERFACE_INCLUDE_DIRECTORIES>, -I>")
set(mbedtls_definitions "-D$<JOIN:$<TARGET_PROPERTY:mbedTLS,INTERFACE_COMPILE_DEFINITIONS>, -D>")

set(aos_cxx_flags
    "${external_project_cxx_flags} -include ${AOS_CORE_CONFIG} ${mbedtls_includes} '${mbedtls_definitions}' \
    -Wno-pedantic -Wno-error"
)
set(aoscore_build_dir ${CMAKE_CURRENT_BINARY_DIR}/aoscore)

ExternalProject_Add(
    aoscore
    PREFIX ${aoscore_build_dir}
    CMAKE_ARGS -DCMAKE_INSTALL_PREFIX=${aoscore_build_dir}
               -DCMAKE_C_COMPILER=${CMAKE_C_COMPILER}
               -DCMAKE_CXX_COMPILER=${CMAKE_CXX_COMPILER}
               -DCMAKE_SYSTEM_NAME=${CMAKE_SYSTEM_NAME}
               -DCMAKE_SYSTEM_PROCESSOR=${CMAKE_SYSTEM_PROCESSOR}
               -DCMAKE_CXX_FLAGS=${aos_cxx_flags}
               -DWITH_MBEDTLS=OFF
    SOURCE_DIR ${aoscore_source_dir}
    BUILD_BYPRODUCTS ${aoscore_build_dir}/lib/libaossm.a ${aoscore_build_dir}/lib/libaosiam.a
                     ${aoscore_build_dir}/lib/libaoscommon.a
    DEPENDS zephyr_interface
)

file(MAKE_DIRECTORY ${aoscore_build_dir}/include)

# aossm

add_library(aossm STATIC IMPORTED GLOBAL)

add_dependencies(aossm aoscore)

set_target_properties(aossm PROPERTIES IMPORTED_LOCATION ${aoscore_build_dir}/lib/libaossm.a)
set_target_properties(aossm PROPERTIES INTERFACE_INCLUDE_DIRECTORIES ${aoscore_build_dir}/include)

target_link_libraries(app PUBLIC aossm)

# aosiam

add_library(aosiam STATIC IMPORTED GLOBAL)

add_dependencies(aosiam aoscore)

set_target_properties(aosiam PROPERTIES IMPORTED_LOCATION ${aoscore_build_dir}/lib/libaosiam.a)
set_target_properties(aosiam PROPERTIES INTERFACE_INCLUDE_DIRECTORIES ${aoscore_build_dir}/include)

target_link_libraries(app PUBLIC aosiam)

# aoscommon

add_library(aoscommon STATIC IMPORTED GLOBAL)

add_dependencies(aoscommon aoscore)

set_target_properties(aoscommon PROPERTIES IMPORTED_LOCATION ${aoscore_build_dir}/lib/libaoscommon.a)
set_target_properties(aoscommon PROPERTIES INTERFACE_INCLUDE_DIRECTORIES ${aoscore_build_dir}/include)

target_link_libraries(app PUBLIC aoscommon)

# ######################################################################################################################
# Prepare softhsm2 config
# ######################################################################################################################

if(CONFIG_NATIVE_APPLICATION)
    set(tokendir ${CONFIG_AOS_HSM_DIR})

    if(NOT IS_ABSOLUTE ${tokendir})
        set(tokendir ${CMAKE_CURRENT_BINARY_DIR}/${tokendir})
    endif()

    file(COPY misc/softhsm2.conf DESTINATION ${CMAKE_CURRENT_BINARY_DIR}/softhsm)
    file(APPEND ${CMAKE_CURRENT_BINARY_DIR}/softhsm/softhsm2.conf "directories.tokendir = ${tokendir}/\n")
endif()
```

## Kconfig
```
# Copyright (C) 2023 Renesas Electronics Corporation.
# Copyright (C) 2023 EPAM Systems, Inc.
#
# SPDX-License-Identifier: Apache-2.0

mainmenu "Aos zephyr application"

config AOS_DOMD_ID
	int "DomD id"
	default 1

config AOS_CHAN_TX_PATH
	string "Path to TX channel"
	depends on !NATIVE_APPLICATION
	default "/local/domain/1/tmp/vchan/aos/tx"

config AOS_CHAN_RX_PATH
	string "Path to RX channel"
	depends on !NATIVE_APPLICATION
	default "/local/domain/1/tmp/vchan/aos/rx"

config AOS_REBOOT_XEN_STORE_PATH
	string "Path to user reboot request"
	default "/local/domain/1/data/user-reboot"

config AOS_DISK_MOUNT_POINT
	string "Disk mount point"
	default "/lfs"

config AOS_LOG_BACKEND_FS_DIR
	string "Path to the log directory"
	default "/lfs/aos/logs"

config AOS_LOG_BACKEND_FS_FILE_SIZE
	int "Log file size"
	default 20480

config AOS_LOG_BACKEND_FS_FILE_PREFIX
	string "Log file prefix"
	default "log_"

config AOS_LOG_BACKEND_FS_FILES_LIMIT
	int "Log file count"
	default 2

config AOS_STORAGE_DIR
	string "Path to the storage"
	default "/lfs/aos/storage"

config AOS_RUNTIME_DIR
	string "Aos runtime dir"
	default "/tmp/aos/runtime"

config AOS_DOWNLOAD_DIR
	string "Aos download dir"
	default "/lfs/aos/download"

config AOS_SERVICES_DIR
	string "Aos services dir"
	default "/lfs/aos/services"

config AOS_LAYERS_DIR
	string "Aos layers dir"
	default "/lfs/aos/layers"

config AOS_LAUNCHER_STATE_DIR
	string "Aos launcher state dir"
	default "/lfs/aos/launcher/states"

config AOS_LAUNCHER_STORAGE_DIR
	string "Aos launcher storage dir"
	default "/lfs/aos/launcher/storages"

config AOS_LAUNCHER_WORK_DIR
	string "Aos launcher work dir"
	default "/lfs/aos/launcher"

config AOS_NODE_CONFIG_FILE
	string "Node configuration file path"
	default "/lfs/aos/node_config.cfg"

config AOS_NODE_STATUS_FILE
	string "Path to provisioning state file."
	default "/lfs/aos/.nodestatus"

config AOS_NODE_ID_FILE
	string "Path to node id file."
	default "/lfs/aos/node-id"

config AOS_PKCS11_MODULE_PIN_FILE
	string "Path to PKCS11 module PIN file."
	default "/lfs/aos/.pkcs11pin"

config AOS_HSM_DIR
	string "Path HSM tokens dir."
	default "/lfs/tee"

config AOS_NODE_NAME
	string "Node name"
	default "zephyr"

config AOS_NODE_TYPE
	string "Node type"
	default "NODE_TYPE1"

config AOS_CLOCK_SYNC_SEND_PERIOD_SEC
	int "Send clock sync period in seconds"
	default 60

config AOS_CLOCK_SYNC_TIMEOUT_SEC
	int "Clock becomes unsynced if there is no clock sync update during this period."
	default 600

config AOS_CLOCK_SYNC_MAX_DIFF_MSEC
	int "Maximum allowed difference between source and current time."
	default 10000

config AOS_MAX_CPU_DMIPS
	int "Maximum CPU DMIPS"
	default 10000

config AOS_ROOT_CA_PATH
	string "Path to Aos Root CA certificate. Required to build in root CA into app image."
	default "prebuilt/rootca.pem"

config AOS_IAM_OPEN_PORT
	int "Aos IAM open port"
	default 1

config AOS_IAM_SECURE_PORT
	int "Aos IAM secure port"
	default 2

config AOS_SM_OPEN_PORT
	int "Aos SM open port"
	default 3

config AOS_SM_SECURE_PORT
	int "Aos SM secure port"
	default 4

config AOS_SOCKET_SERVER_ADDRESS
	string "Aos socket server address"
	depends on NATIVE_APPLICATION
	default "10.0.0.100"

config AOS_SOCKET_SERVER_PORT
	int "Aos socket server port"
	depends on NATIVE_APPLICATION
	default 30001

config AOS_PBHANDLER_THREAD_STACK_SIZE
	int "Aos PB handler stack size"
	default 32768

config AOS_LAUNCHER_THREAD_STACK_SIZE
	int "Aos launcher stack size"
	default 32768

config DOMD_ENABLE
	bool "Enable Domain-D creation"
	default y

config DOMD_UBOOT_PATH
	string "Location for Domain-D IPL binary"
	depends on DOMD_ENABLE
	default "prebuilt/ipl.bin"

config DOMD_DTB_PATH
	string "Location of Domain-D partial device-tree"
	depends on DOMD_ENABLE
	default "prebuilt/ipl.dtb"

config DOMU_ENABLE
	bool "Enable Domain-U creation"

config DOMU_BIN_PATH
	string "Location for Domain-U binary"
	depends on DOMU_ENABLE
	default "prebuilt/domu.bin"

config DOMU_DTB_PATH
	string "Location for Domain-U device-tree"
	depends on DOMU_ENABLE
	default "prebuilt/domu.dtb"

config TA_DEPLOY_DIR
	string "Location of optee TA's deploy dir"

module = AOS_CORE
module-str = Aos core
source "subsys/logging/Kconfig.template.log_config"

module = AOS_CORE_RUNTIME
module-str = Aos core runtime
source "subsys/logging/Kconfig.template.log_config"

source "Kconfig"
```

## west.yml
```
#
# Copyright (C) 2023 Renesas Electronics Corporation.
# Copyright (C) 2023 EPAM Systems, Inc.
#
# SPDX-License-Identifier: Apache-2.0
#

# West YAML manifest for Zephyr as Xen Dom0

manifest:
  self:
    path: aos_core_zephyr

  remotes:
    - name: xen-troops
      url-base: https://github.com/xen-troops

    - name: aosedge
      url-base: https://github.com/aosedge

    - name: zephyrproject-rtos
      url-base: https://github.com/zephyrproject-rtos

  projects:
    - name: zephyr
      remote: xen-troops
      revision: "zephyr-v3.6.0-xt"
      west-commands: scripts/west-commands.yml

    - name: aos_core_lib_cpp
      remote: aosedge
      revision: "26c355e863a88136b77118fade7e00e4048944d5"

    - name: aos_core_api
      remote: aosedge
      revision: "develop"

    - name: zephyr-xenlib
      remote: xen-troops
      revision: "main"

    - name: zephyr-optee-client
      remote: xen-troops
      revision: "master"

    - name: zephyr-xrun
      remote: xen-troops
      revision: "main"

    - name: littlefs
      remote: zephyrproject-rtos
      revision: "zephyr"
      path: modules/fs/littlefs
      groups:
        - fs

    - name: fatfs
      remote: zephyrproject-rtos
      revision: "427159bf95ea49b7680facffaa29ad506b42709b"
      path: modules/fs/fatfs
      groups:
        - fs

    - name: nanopb
      remote: zephyrproject-rtos
      revision: "zephyr"
      path: modules/lib/nanopb

    - name: mbedtls
      remote: zephyrproject-rtos
      revision: "a78176c6ff0733ba08018cba4447bd3f20de7978"
      path: modules/crypto/mbedtls
      groups:
        - crypto
```

## prj.conf
```kconfig
#
# Copyright (c) 2023 EPAM Systems
#
# SPDX-License-Identifier: Apache-2.0
#

# ######################################################################################################################
# System params
# ######################################################################################################################

# Set mem parameters
CONFIG_HEAP_MEM_POOL_SIZE=2097152

# Enable userspace
CONFIG_USERSPACE=y

# Set stack size
CONFIG_MAIN_STACK_SIZE=32768

# Select libc
CONFIG_PICOLIBC=y

# Increase KOBJECT RODATA
CONFIG_KOBJECT_RODATA_AREA_EXTRA_BYTES=2048

# ######################################################################################################################
# Enable C++
# ######################################################################################################################

CONFIG_CPP=y
CONFIG_STD_CPP17=y

# ######################################################################################################################
# Logging, errors etc.
# ######################################################################################################################

# Enable logging

CONFIG_LOG=y
CONFIG_LOG_FUNC_NAME_PREFIX_ERR=n
CONFIG_LOG_FUNC_NAME_PREFIX_WRN=n
CONFIG_LOG_FUNC_NAME_PREFIX_INF=n
CONFIG_LOG_FUNC_NAME_PREFIX_DBG=n
CONFIG_LOG_DEFAULT_LEVEL=3
CONFIG_LOG_MODE_DEFERRED=y
CONFIG_LOG_BUFFER_SIZE=8192

# Disable FS log to avoid errors duplication. We catch them by Aos errors.
CONFIG_FS_LOG_LEVEL_OFF=y

# Enable assert for debugging purposes
# TODO: remove for release

# Remove due to an issue with the assert in the recent Zephyr code
# CONFIG_ASSERT=y

# ######################################################################################################################
# POSIX configuration
# ######################################################################################################################

CONFIG_PTHREAD_IPC=y
CONFIG_POSIX_API=y
CONFIG_POSIX_FS=y
CONFIG_MAX_PTHREAD_COUNT=16
CONFIG_MAX_PTHREAD_MUTEX_COUNT=64
CONFIG_MAX_PTHREAD_COND_COUNT=32
CONFIG_MAX_THREAD_BYTES=3

# ######################################################################################################################
# 3rd parties modules
# ######################################################################################################################

# Enable mbedtls

CONFIG_MBEDTLS=y
CONFIG_MBEDTLS_BUILTIN=y
CONFIG_MBEDTLS_ENABLE_HEAP=y
CONFIG_MBEDTLS_HEAP_SIZE=131072
CONFIG_MBEDTLS_ZEPHYR_ENTROPY=y
CONFIG_MBEDTLS_USER_CONFIG_ENABLE=y
CONFIG_MBEDTLS_USER_CONFIG_FILE="aosmbedtlsconfig.h"

CONFIG_MBEDTLS_CIPHER_CCM_ENABLED=y
CONFIG_MBEDTLS_ECDH_C=y
CONFIG_MBEDTLS_ECDSA_C=y
CONFIG_MBEDTLS_ECP_C=y
CONFIG_MBEDTLS_ECP_DP_SECP256R1_ENABLED=y
CONFIG_MBEDTLS_ECP_DP_SECP384R1_ENABLED=y
CONFIG_MBEDTLS_KEY_EXCHANGE_ECDHE_ECDSA_ENABLED=y
CONFIG_MBEDTLS_KEY_EXCHANGE_RSA_ENABLED=y
CONFIG_MBEDTLS_PEM_CERTIFICATE_FORMAT=y
CONFIG_MBEDTLS_PK_WRITE_C=y
CONFIG_MBEDTLS_PSA_CRYPTO_C=y
CONFIG_MBEDTLS_SSL_MAX_CONTENT_LEN=16384
CONFIG_MBEDTLS_TLS_VERSION_1_2=y

# Enable JSON library

CONFIG_JSON_LIBRARY=y

# Enable nanopb library

CONFIG_NANOPB=y

# ######################################################################################################################
# System components
# ######################################################################################################################

# Enable shell support

CONFIG_SHELL=y
CONFIG_SHELL_BACKEND_SERIAL=y

# Enable file system

CONFIG_FILE_SYSTEM=y
CONFIG_FILE_SYSTEM_SHELL=y
CONFIG_FILE_SYSTEM_LITTLEFS=y

# Configure 

CONFIG_FS_LITTLEFS_CACHE_SIZE=512
CONFIG_FS_LITTLEFS_LOOKAHEAD_SIZE=2048
CONFIG_FS_LITTLEFS_NUM_FILES=8

# Enable FLASH

CONFIG_FLASH=y
CONFIG_FLASH_SHELL=y
CONFIG_FLASH_SIMULATOR=y
CONFIG_FLASH_MAP=y

# Enable cpu power management

CONFIG_PM_CPU_OPS=y

# WA: Disable MMC_DMA to avoid z_mem_phys_add assertion
CONFIG_RCAR_MMC_DMA_SUPPORT=n

# Requires by mbedTLS for entropy. Need to be replaced with HW solution.
CONFIG_TEST_RANDOM_GENERATOR=y

# ######################################################################################################################
# Enable OP-TEE driver and client libraries
# ######################################################################################################################

CONFIG_TEE=y
CONFIG_OPTEE=y

CONFIG_OPTEE_CLIENT=y
CONFIG_OPTEE_LIBTEEC=y
CONFIG_OPTEE_LIBCKTEEC=y
CONFIG_OPTEE_TEE_SUPPLICANT=y
CONFIG_OPTEE_TEE_SUPPLICANT_AUTOINIT=n
CONFIG_OPTEE_STORAGE_ROOT="/aos/tee"

# ######################################################################################################################
# Xen and its components
# ######################################################################################################################

# Enable xen

CONFIG_XEN_DOMAIN_MANAGEMENT=y
CONFIG_XEN_CONSOLE_SRV=y
CONFIG_XEN_STORE_SRV=y
CONFIG_XEN_LIBFDT=y
CONFIG_XEN_SHELL=y

# Enable xrun

CONFIG_XRUN=y
CONFIG_XRUN_SHELL_CMDS=y

# Enable xstat

CONFIG_XSTAT=y
CONFIG_XSTAT_SHELL_CMDS=y

# Enable vchan

CONFIG_XEN_VCH=y
CONFIG_VCH_PATH_MAXLEN=48
```

## boards/native_posix_64.conf
```kconfig
#
# Copyright (c) 2023 EPAM Systems
#
# SPDX-License-Identifier: Apache-2.0
#

# Enable heap auto configuration

CONFIG_SYS_HEAP_AUTO=y

# Disable Newlib

CONFIG_NEWLIB_LIBC=n
CONFIG_NEWLIB_LIBC_NANO=n

# Configure logs

CONFIG_LOG_DEFAULT_LEVEL=4
CONFIG_LOG_BACKEND_NATIVE_POSIX=y
CONFIG_SHELL_LOG_BACKEND=n
CONFIG_LOG_MODE_IMMEDIATE=y

CONFIG_AOS_LOG_BACKEND_FS_DIR=".aos/logs"
CONFIG_AOS_LOG_BACKEND_FS_FILE_SIZE=10240
CONFIG_AOS_LOG_BACKEND_FS_FILES_LIMIT=10

# Enable debugging

CONFIG_NO_OPTIMIZATIONS=y
CONFIG_DEBUG_INFO=y
CONFIG_DEBUG=y

# Slow down to real time

CONFIG_NATIVE_POSIX_SLOWDOWN_TO_REAL_TIME=y

# Disable userspace

CONFIG_USERSPACE=n

# Disable errno strerror

CONFIG_MINIMAL_LIBC_STRING_ERROR_TABLE=n

# Disable posix config

CONFIG_PTHREAD_IPC=n
CONFIG_POSIX_API=n
CONFIG_POSIX_FS=n
CONFIG_MAX_PTHREAD_COUNT=0
CONFIG_MAX_PTHREAD_MUTEX_COUNT=0
CONFIG_MAX_THREAD_BYTES=0

# Disable cpu power management

CONFIG_PM_CPU_OPS=n

# Disable xen

CONFIG_XEN_DOMAIN_MANAGEMENT=n
CONFIG_XEN_CONSOLE_SRV=n
CONFIG_XEN_STORE_SRV=n
CONFIG_XEN_LIBFDT=n
CONFIG_XEN_STORE_SRV=n
CONFIG_XEN_SHELL=n

# Disable vchan

CONFIG_XEN_VCH=n

# Disable xstat

CONFIG_XSTAT=n
CONFIG_XSTAT_SHELL_CMDS=n

# Disable xrun

CONFIG_XRUN=n
CONFIG_XRUN_SHELL_CMDS=n

# Application config

CONFIG_AOS_DISK_MOUNT_POINT=".aos"
CONFIG_AOS_STORAGE_DIR=".aos/storage"
CONFIG_AOS_RUNTIME_DIR=".aos/runtime"
CONFIG_AOS_DOWNLOAD_DIR=".aos/download"
CONFIG_AOS_SERVICES_DIR=".aos/services"
CONFIG_AOS_LAUNCHER_STATE_DIR=".aos/launcher/states"
CONFIG_AOS_LAUNCHER_STORAGE_DIR=".aos/launcher/storages"
CONFIG_AOS_LAUNCHER_WORK_DIR=".aos/launcher"
CONFIG_AOS_LAYERS_DIR=".aos/layers"
CONFIG_AOS_NODE_CONFIG_FILE=".aos/node_config.cfg"
CONFIG_AOS_HSM_DIR=".aos/hsm"
CONFIG_AOS_NODE_STATUS_FILE=".aos/.nodestatus"
CONFIG_AOS_NODE_ID_FILE=".aos/node-id"
CONFIG_AOS_PKCS11_MODULE_PIN_FILE=".aos/.pkcs11pin"

# Disable OP-TEE driver and client libraries
# TEE is not supported by this platform
CONFIG_TEE=n
CONFIG_OPTEE=n

CONFIG_OPTEE_CLIENT=n
CONFIG_OPTEE_LIBTEEC=n
CONFIG_OPTEE_LIBCKTEEC=n
CONFIG_OPTEE_TEE_SUPPLICANT=n
```

## boards/rpi_5.conf
```kconfig
# Copyright (c) 2024 EPAM Systems
# SPDX-License-Identifier: Apache-2.0

CONFIG_IPM_CONSOLE_STACK_SIZE=4096

CONFIG_KERNEL_VM_SIZE=0x1000000

CONFIG_XEN_DOMCTL_INTERFACE_VERSION=0x16

CONFIG_XEN_DOM0=y
CONFIG_XEN_DOM0LESS_BOOT=y

CONFIG_NOCACHE_MEMORY=y
CONFIG_FS_MULTI_PARTITION=y

CONFIG_FILE_SYSTEM_LITTLEFS=n

CONFIG_FAT_FILESYSTEM_ELM=y
CONFIG_FS_FATFS_EXFAT=y
CONFIG_FS_FATFS_LBA64=y
CONFIG_FS_FATFS_NUM_FILES=16
CONFIG_FS_FATFS_REENTRANT=y
CONFIG_FS_FATFS_LFN_MODE_STACK=y

CONFIG_DOMD_ENABLE=n

CONFIG_OPTEE_STORAGE_ROOT="/1:/tee"

CONFIG_AOS_LOG_BACKEND_FS_DIR="/1:/aos/logs"
CONFIG_AOS_LOG_BACKEND_FS_FILE_SIZE=4096
CONFIG_AOS_LOG_BACKEND_FS_FILES_LIMIT=10

CONFIG_AOS_STORAGE_DIR="/1:/aos/storage"
CONFIG_AOS_RUNTIME_DIR="/2:/tmp/aos/runtime"
CONFIG_AOS_DOWNLOAD_DIR="/1:/aos/download"
CONFIG_AOS_SERVICES_DIR="/1:/aos/services"
CONFIG_AOS_LAUNCHER_STATE_DIR="/1:/aos/launcher/states"
CONFIG_AOS_LAUNCHER_STORAGE_DIR="/1:/aos/launcher/storages"
CONFIG_AOS_LAUNCHER_WORK_DIR="/1:/aos/launcher"
CONFIG_AOS_LAYERS_DIR="/1:/aos/layers"
CONFIG_AOS_NODE_CONFIG_FILE="/1:/aos/node_config.cfg"
CONFIG_AOS_DISK_MOUNT_POINT="/1:"
CONFIG_AOS_NODE_STATUS_FILE="/1:/aos/.nodestatus"
CONFIG_AOS_NODE_ID_FILE="/1:/aos/node-id"
CONFIG_AOS_PKCS11_MODULE_PIN_FILE="/1:/aos/.pkcs11pin"
CONFIG_AOS_HSM_DIR="/1:/tee"
```

## src/main.cpp
```c
/*
 * Copyright (C) 2023 Renesas Electronics Corporation.
 * Copyright (C) 2023 EPAM Systems, Inc.
 *
 * SPDX-License-Identifier: Apache-2.0
 */

#include <zephyr/sys/__assert.h>
#include <zephyr/sys/printk.h>

#include <aos/common/tools/string.hpp>
#include <aos/common/version.hpp>

#include "app/app.hpp"
#include "logger/fsbackend.hpp"
#include "logger/logger.hpp"
#include "utils/utils.hpp"

// cppcheck-suppress missingInclude
#include "version.hpp"

#if !defined(CONFIG_NATIVE_APPLICATION)
#include <tee_supplicant.h>

#include "bsp/mount.h"
#include "bsp/reboot.h"
#include "domains/dom_runner.h"
#endif

using namespace aos::zephyr;

int main(void)
{
    logger::backend::SetLogCustomTimestamp();

    printk("*** Aos zephyr application: %s ***\n", AOS_ZEPHYR_APP_VERSION);
    printk("*** Aos core library: %s ***\n", AOS_CORE_VERSION);
    printk("*** Aos core size: %lu ***\n", sizeof(app::App));

#if !defined(CONFIG_NATIVE_APPLICATION)
    auto ret = mount_fs();
    __ASSERT(ret == 0, "Error mounting FS: %s [%d]", strerror(ret), ret);

    ret = TEE_SupplicantInit();
    __ASSERT(ret == 0, "Error initializing TEE supplicant: %s [%d]", strerror(ret), ret);

    reboot_watcher_init();

    ret = create_domains();
    __ASSERT(ret == 0, "Error creating domains: %s [%d]", strerror(ret), ret);
#endif

    auto err = logger::Logger::Init();
    __ASSERT(err.IsNone(), "Error initializing logger: %s", utils::ErrorToCStr(err));

    err = logger::backend::FSBackend::Get().Init();
    __ASSERT(err.IsNone(), "Error initializing fs backend logger: %s", utils::ErrorToCStr(err));

    auto& app = aos::zephyr::app::App::Get();

    atexit([]() {
        auto err = aos::zephyr::app::App::Get().Stop();
        if (!err.IsNone()) {
            printk("Error stopping application: %s\n", utils::ErrorToCStr(err));

            _exit(1);
        }

        printk("Application stopped\n");

        _exit(0);
    });

    err = app.Init();
    __ASSERT(err.IsNone(), "Error initializing application: %s", utils::ErrorToCStr(err));

    err = app.Start();
    __ASSERT(err.IsNone(), "Error starting application: %s", utils::ErrorToCStr(err));

    return 0;
}
```
